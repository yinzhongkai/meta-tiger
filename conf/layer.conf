## conf/machine/tiger.conf
```bitbake
# SPDX-License-Identifier: MIT
# Chapter 4 fixture machine; deliberately not a Linux BSP or a virt include.
require conf/machine/include/arm/armv8a/tune-cortexa53.inc

MACHINE_FEATURES = ""
QEMU_TARGETS = "aarch64"

QB_SYSTEM_NAME = "qemu-system-aarch64"
QB_MACHINE = "-machine tiger -accel tcg"
QB_CPU = "-cpu cortex-a53"
QB_SMP = "-smp 1"
QB_MEM = "-m 1024"
QB_DEFAULT_KERNEL = "none"
QB_DEFAULT_FSTYPE = "none"
QB_ROOTFS = "none"
QB_DEFAULT_BIOS = "tiger-minboot-0.1-tiger.bin"
QB_NET = "none"
QB_KERNEL_CMDLINE = "none"
QB_RNG = ""
QB_GRAPHICS = ""
QB_OPT_APPEND = ""
QB_ROOTFS_OPT = ""
QB_NETWORK_DEVICE = ""
QB_TAP_OPT = ""
QB_TCPSERIAL_OPT = ""
QB_SERIAL_OPT = ""
SERIAL_CONSOLES = ""
QB_CPU_KVM = ""
QB_KERNEL_CMDLINE_APPEND = ""
```
